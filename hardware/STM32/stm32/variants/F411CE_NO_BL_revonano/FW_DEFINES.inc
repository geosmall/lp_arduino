-DUSE_INPUT_LPF
-DUSE_GIMBAL_LPF
-DUSE_GIMBAL_FF
-DDIAG_TASKS
-DSTM32F4XX
-DSTM32F411xE
-DSYSCLK_FREQ=96000000
-DHSE_VALUE=8000000
-DUSE_STDPERIPH_DRIVER
-DARM_MATH_CM4
-D__FPU_PRESENT=1
-DMODULE_SENSORS_BUILTIN
-DMODULE_STATEESTIMATION_BUILTIN
-DMODULE_AIRSPEED_BUILTIN
-DMODULE_STABILIZATION_BUILTIN
-DMODULE_MANUALCONTROL_BUILTIN
-DMODULE_RECEIVER_BUILTIN
-DMODULE_ACTUATOR_BUILTIN
-DMODULE_GPS_BUILTIN
-DMODULE_TXPID_BUILTIN
-DMODULE_CAMERASTAB_BUILTIN
-DMODULE_BATTERY_BUILTIN
-DMODULE_FIRMWAREIAP_BUILTIN
-DMODULE_PATHPLANNER_BUILTIN
-DMODULE_PATHFOLLOWER_BUILTIN
-DMODULE_TELEMETRY_BUILTIN
-DMODULE_NOTIFY_BUILTIN
-DUSE_STM32F4xx_RN
-DBOARD_TYPE=0x09
-DBOARD_REVISION=0x05
-DHW_TYPE=0x00
-DBOOTLOADER_VERSION=0x06
-DFW_BANK_BASE=0x08010000
-DFW_BANK_SIZE=0x00070000
-DFW_DESC_SIZE=0x00000064
-DBL_BANK_BASE=0x08000000
-DBL_BANK_SIZE=0x00008000
-DBL_DESC_SIZE=
-DEE_BANK_BASE=0x08008000
-DEE_BANK_SIZE=0x00008000
-DPIOS_ENABLE_CXX